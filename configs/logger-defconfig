## configs/logger-defconfig
```kconfig
CONFIG_SDK_USER_ENTRYPOINT="logger_entry"

CONFIG_CXD56_GNSS=y
CONFIG_GPSUTILS_CXD56NMEA_LIB=y

CONFIG_GNSSLOGGER_LOGGER=y
CONFIG_GNSSLOGGER_LOGGER_PRIORITY=100
CONFIG_GNSSLOGGER_LOGGER_STACKSIZE=2048
```

## logger/Kconfig
```kconfig
config GNSSLOGGER_LOGGER
	tristate "GNSS SD Card Logger"
	default y
	---help---
		Enable the logger app

if GNSSLOGGER_LOGGER

config GNSSLOGGER_LOGGER_PROGNAME
	string "Program name"
	default "logger"
	---help---
		This is the name of the program that will be use when the NSH ELF
		program is installed.

config GNSSLOGGER_LOGGER_PRIORITY
	int "logger task priority"
	default 100

config GNSSLOGGER_LOGGER_STACKSIZE
	int "logger stack size"
	default 2048

config GNSSLOGGER_LOGGER_SAVEFILE
	bool "Save NMEA file"
	default y
	---help---
		Enable saving nmea file to SD

config GNSSLOGGER_LOGGER_OUTPUT_SERIAL
	bool "Output NMEA to serial"
	default y
	---help---
		Enable output nmea to SD

endif
```
